## prj.conf
```kconfig
#
# Copyright (c) 2018 Nordic Semiconductor
#
# SPDX-License-Identifier: LicenseRef-Nordic-5-Clause
#

# Enable the UART driver
CONFIG_UART_ASYNC_API=y
CONFIG_NRFX_UARTE=y
CONFIG_SERIAL=y

CONFIG_GPIO=y

# Make sure printk is printing to the UART console
CONFIG_CONSOLE=y
CONFIG_UART_CONSOLE=y

CONFIG_HEAP_MEM_POOL_SIZE=2048

CONFIG_BT=y
CONFIG_BT_PERIPHERAL=y
CONFIG_BT_DEVICE_NAME="Nordic_UART_Lihua"
CONFIG_BT_MAX_CONN=1
CONFIG_BT_MAX_PAIRED=1

# Enable the NUS service
CONFIG_BT_NUS=y

# Enable bonding
CONFIG_BT_SETTINGS=y
CONFIG_FLASH=y
CONFIG_FLASH_PAGE_LAYOUT=y
CONFIG_FLASH_MAP=y

# Enable DK LED and Buttons library
CONFIG_DK_LIBRARY=y

CONFIG_SYSTEM_WORKQUEUE_STACK_SIZE=2048
# Config logger
CONFIG_LOG=y
CONFIG_USE_SEGGER_RTT=y
CONFIG_LOG_BACKEND_RTT=y
CONFIG_LOG_BACKEND_UART=n
CONFIG_LOG_PRINTK=n

CONFIG_ASSERT=y

#Enable I2C and LIS2DH sensor
CONFIG_I2C=y
CONFIG_SENSOR=y
CONFIG_LIS2DH=y
#CONFIG_LIS2DH_ODR_1=y
CONFIG_LIS2DH_ODR_RUNTIME=y

# Time resolution set to 1ms
CONFIG_SYS_CLOCK_TICKS_PER_SEC=1000

# get 247-byte MTU (244 bytes usable payload)
CONFIG_BT_L2CAP_TX_MTU=247
CONFIG_BT_BUF_ACL_RX_SIZE=251
CONFIG_BT_BUF_ACL_TX_SIZE=251
CONFIG_BT_CTLR_DATA_LENGTH_MAX=251

# DLE (Data Length Extension) for nRF52832
CONFIG_BT_CTLR_DATA_LENGTH_MAX=251

CONFIG_PM=y
CONFIG_PM_DEVICE=y
CONFIG_SYSTEM_CLOCK_NO_WAIT=y
```

## src/main.c
```c
#include <zephyr/kernel.h>
#include <zephyr/drivers/sensor.h>
#include <zephyr/logging/log.h>

LOG_MODULE_REGISTER(accel_sleep_demo);

#define ACCEL_SAMPLE_RATE_HZ 100
#define ACCEL_INTERVAL_MS (1000 / ACCEL_SAMPLE_RATE_HZ)  // 10ms

const struct device *const accel_dev = DEVICE_DT_GET_ANY(st_lis2dh);

K_SEM_DEFINE(wake_sem, 0, 1);
static struct k_timer sample_timer;

/* Timer ISR — just signals the thread, does no work itself.
 * Keeping ISR work minimal means the CPU can go back to sleep
 * faster after handling the wake event. */
static void sample_timer_expiry(struct k_timer *timer)
{
    k_sem_give(&wake_sem);
}

static inline int16_t sv_to_i16(struct sensor_value *v)
{
    return (int16_t)(v->val1 * 100 + v->val2 / 10000);
}

static void accel_sample_thread(void)
{
    if (!device_is_ready(accel_dev)) {
        LOG_ERR("LIS3DH not ready");
        return;
    }

    /* Set ODR once at startup — sensor free-runs internally at its
     * own low current regardless of what the CPU is doing */
    struct sensor_value odr = { .val1 = ACCEL_SAMPLE_RATE_HZ, .val2 = 0 };
    sensor_attr_set(accel_dev, SENSOR_CHAN_ACCEL_XYZ,
                     SENSOR_ATTR_SAMPLING_FREQUENCY, &odr);

    k_timer_init(&sample_timer, sample_timer_expiry, NULL);
    k_timer_start(&sample_timer, K_MSEC(ACCEL_INTERVAL_MS), K_MSEC(ACCEL_INTERVAL_MS));

    struct sensor_value accel[3];

    while (1) {
        /* CPU sleeps here — k_sem_take with K_FOREVER blocks this
         * thread, Zephyr's idle thread takes over and calls
         * k_cpu_idle(), entering System ON sleep until the timer
         * ISR above fires and gives the semaphore */
        k_sem_take(&wake_sem, K_FOREVER);

        /* Woken up — do the actual I2C read now */
        if (sensor_sample_fetch(accel_dev) == 0 &&
            sensor_channel_get(accel_dev, SENSOR_CHAN_ACCEL_XYZ, accel) == 0) {

            int16_t z = sv_to_i16(&accel[2]);
            //LOG_INF("Z: %d", z);

            /* ... pack into your BLE packet / buffer here ... */
        }

        /* Falls back to k_sem_take → CPU sleeps again until next tick */
    }
}

#define ACCEL_THREAD_STACK_SIZE 1024
#define ACCEL_THREAD_PRIORITY   8

K_THREAD_DEFINE(accel_sample_thread_id,
                ACCEL_THREAD_STACK_SIZE,
                accel_sample_thread,
                NULL, NULL, NULL,
                ACCEL_THREAD_PRIORITY, 0, 0);
```
